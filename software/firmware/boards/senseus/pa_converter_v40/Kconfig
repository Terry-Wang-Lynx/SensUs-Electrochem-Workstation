## software/firmware/boards/senseus/pa_converter_v40/Kconfig.pa_converter_v40
```kconfig
# pA-Converter V4.0(自定义板)· hwmv2 入口

config BOARD_PA_CONVERTER_V40
	bool "pA-Converter V4.0 (custom)"
	select SOC_NRF52833_QDAA
```

## software/firmware/boards/senseus/pa_converter_v40/board.yml
```yaml
board:
  name: pa_converter_v40
  full_name: pA-Converter V4.0 (custom)
  vendor: senseus
  socs:
    - name: nrf52833
```

## software/firmware/boards/senseus/pa_converter_v51/Kconfig.pa_converter_v51
```kconfig
config BOARD_PA_CONVERTER_V51
	bool "pA-Converter V5.1 (custom, USB)"
	select SOC_NRF52833_QDAA
```

## software/firmware/boards/senseus/pa_converter_v51/board.yml
```yaml
board:
  name: pa_converter_v51
  full_name: pA-Converter V5.1 (custom, USB)
  vendor: senseus
  socs:
    - name: nrf52833
```
